## prj.conf
```kconfig
CONFIG_TEST=y
CONFIG_BT_TESTING=y
CONFIG_CONSOLE_HANDLER=y
CONFIG_USERSPACE=n
CONFIG_NO_OPTIMIZATIONS=y

CONFIG_BT=y
CONFIG_BT_CENTRAL=y
CONFIG_BT_PERIPHERAL=y
CONFIG_BT_DEVICE_NAME="bsim_test_audio"
CONFIG_BT_L2CAP_TX_BUF_COUNT=20
CONFIG_BT_MAX_CONN=5
CONFIG_BT_MAX_PAIRED=5
CONFIG_BT_GATT_DYNAMIC_DB=y
CONFIG_BT_SMP=y

# Needed for extended advertising
CONFIG_BT_EXT_ADV_LEGACY_SUPPORT=y

CONFIG_BT_CTLR_ADV_DATA_LEN_MAX=191
CONFIG_BT_CTLR_SCAN_DATA_LEN_MAX=191

CONFIG_BT_AUDIO=y
CONFIG_BT_AUDIO_UNICAST_SERVER=y
CONFIG_BT_AUDIO_UNICAST_CLIENT=y
CONFIG_BT_AUDIO_UNICAST_CLIENT_GROUP_STREAM_COUNT=2
CONFIG_BT_AUDIO_BROADCAST_SOURCE=y
CONFIG_BT_AUDIO_BROADCAST_SINK=y
# Only 1 stream support by controller at this point
CONFIG_BT_AUDIO_BROADCAST_SRC_STREAM_COUNT=1
CONFIG_BT_AUDIO_BROADCAST_SRC_SUBGROUP_COUNT=1
# Only 1 stream support by controller at this point
CONFIG_BT_AUDIO_BROADCAST_SNK_SUBGROUP_COUNT=1
CONFIG_BT_AUDIO_BROADCAST_SNK_STREAM_COUNT=1
CONFIG_BT_ISO_TX_BUF_COUNT=4

# Needed for Periodic Advertising Sync Transfer
CONFIG_BT_PER_ADV_SYNC_TRANSFER_RECEIVER=y
CONFIG_BT_PER_ADV_SYNC_TRANSFER_SENDER=y

# Volume Offset Control Service
CONFIG_BT_VOCS_MAX_INSTANCE_COUNT=2
CONFIG_BT_VOCS_CLIENT_MAX_INSTANCE_COUNT=2

# Audio Input Control Service
CONFIG_BT_AICS_MAX_INSTANCE_COUNT=4
CONFIG_BT_AICS_CLIENT_MAX_INSTANCE_COUNT=4

#Volume Control
CONFIG_BT_VCP_VOL_REND=y
CONFIG_BT_VCP_VOL_REND_VOCS_INSTANCE_COUNT=2
CONFIG_BT_VCP_VOL_REND_AICS_INSTANCE_COUNT=2
CONFIG_BT_VCP_VOL_CTLR=y
CONFIG_BT_VCP_VOL_CTLR_MAX_VOCS_INST=2
CONFIG_BT_VCP_VOL_CTLR_MAX_AICS_INST=2

CONFIG_BT_MICP_MIC_DEV=y
CONFIG_BT_MICP_MIC_DEV_AICS_INSTANCE_COUNT=2
CONFIG_BT_MICP_MIC_CTLR=y
CONFIG_BT_MICP_MIC_CTLR_MAX_AICS_INST=2

# Coordinated Set Identification
CONFIG_BT_CSIP_SET_MEMBER=y
CONFIG_BT_CSIP_SET_MEMBER_TEST_SAMPLE_DATA=y
CONFIG_BT_CSIP_SET_COORDINATOR=y
CONFIG_BT_CSIP_SET_COORDINATOR_TEST_SAMPLE_DATA=y

# Telephone bearer service
CONFIG_BT_TBS=y
CONFIG_BT_TBS_CLIENT=y

# Media control
CONFIG_MCTL=y
CONFIG_MCTL_LOCAL_PLAYER_CONTROL=y
CONFIG_MCTL_LOCAL_PLAYER_LOCAL_CONTROL=y
CONFIG_MCTL_LOCAL_PLAYER_REMOTE_CONTROL=y
CONFIG_MCTL_REMOTE_PLAYER_CONTROL=y
CONFIG_MCTL_REMOTE_PLAYER_CONTROL_OBJECTS=y
CONFIG_UTF8=y

# Media player
CONFIG_BT_MPL=y
CONFIG_BT_MPL_OBJECTS=y
CONFIG_BT_MPL_MAX_OBJ_SIZE=600

# Media control
CONFIG_BT_MCS=y
CONFIG_BT_MCC=y
CONFIG_BT_MCC_OTS=y
CONFIG_BT_MCC_SHELL=y
CONFIG_BT_MCC_TOTAL_OBJ_CONTENT_MEM=4096

# Immediate Alert
CONFIG_BT_IAS=y
CONFIG_BT_IAS_CLIENT=y

# Object Transfer
CONFIG_BT_OTS=y
CONFIG_BT_OTS_SECONDARY_SVC=y
CONFIG_BT_OTS_MAX_OBJ_CNT=0x30
CONFIG_BT_OTS_CLIENT=y

# Broadcast Audio Scan Service and client
CONFIG_BT_BAP_SCAN_DELEGATOR=y
CONFIG_BT_BAP_BROADCAST_ASSISTANT=y

# Hearing Access
CONFIG_BT_HAS=y
CONFIG_BT_HAS_CLIENT=y

# Common Audio Profile
CONFIG_BT_CAP_ACCEPTOR=y
CONFIG_BT_CAP_ACCEPTOR_SET_MEMBER=y
CONFIG_BT_CAP_INITIATOR=y

# DEBUGGING
CONFIG_BT_DEBUG_LOG=y
CONFIG_BT_VCP_VOL_REND_LOG_LEVEL_DBG=y
CONFIG_BT_VCP_VOL_CTLR_LOG_LEVEL_DBG=y
CONFIG_BT_AICS_LOG_LEVEL_DBG=y
CONFIG_BT_AICS_CLIENT_LOG_LEVEL_DBG=y
CONFIG_BT_VOCS_LOG_LEVEL_DBG=y
CONFIG_BT_VOCS_CLIENT_LOG_LEVEL_DBG=y
CONFIG_BT_MICP_MIC_DEV_LOG_LEVEL_DBG=y
CONFIG_BT_MICP_MIC_CTLR_LOG_LEVEL_DBG=y
CONFIG_BT_MPL_LOG_LEVEL_DBG=y
CONFIG_BT_TBS_LOG_LEVEL_DBG=y
CONFIG_BT_TBS_CLIENT_LOG_LEVEL_DBG=y
CONFIG_BT_MCS_LOG_LEVEL_DBG=y
CONFIG_BT_MCC_LOG_LEVEL_DBG=y
CONFIG_BT_OTS_LOG_LEVEL_DBG=y
CONFIG_BT_OTS_CLIENT_LOG_LEVEL_DBG=y
CONFIG_MCTL_LOG_LEVEL_DBG=y
CONFIG_BT_CSIP_SET_MEMBER_LOG_LEVEL_DBG=y
CONFIG_BT_CSIP_SET_COORDINATOR_LOG_LEVEL_DBG=y
CONFIG_BT_CSIP_SET_MEMBER_CRYPTO_LOG_LEVEL_DBG=y
CONFIG_BT_AUDIO_UNICAST_CLIENT_LOG_LEVEL_DBG=y
CONFIG_BT_AUDIO_UNICAST_SERVER_LOG_LEVEL_DBG=y
CONFIG_BT_AUDIO_BROADCAST_SINK_LOG_LEVEL_DBG=y
CONFIG_BT_AUDIO_BROADCAST_SOURCE_LOG_LEVEL_DBG=y
CONFIG_BT_ASCS_LOG_LEVEL_DBG=y
CONFIG_BT_PACS_LOG_LEVEL_DBG=y
CONFIG_BT_AUDIO_STREAM_LOG_LEVEL_DBG=y
CONFIG_BT_AUDIO_ISO_LOG_LEVEL_DBG=y
CONFIG_BT_BAP_SCAN_DELEGATOR_LOG_LEVEL_DBG=y
CONFIG_BT_BAP_BROADCAST_ASSISTANT_LOG_LEVEL_DBG=y
CONFIG_BT_HAS_LOG_LEVEL_DBG=y
CONFIG_BT_HAS_CLIENT_LOG_LEVEL_DBG=y
CONFIG_BT_CAP_ACCEPTOR_LOG_LEVEL_DBG=y
CONFIG_BT_DEBUG_CAP_INITIATOR=y

# LOGGING
CONFIG_TEST_LOGGING_DEFAULTS=n
CONFIG_LOG_MODE_IMMEDIATE=y

# Controller configs
CONFIG_BT_CTLR_ADV_ISO=y
CONFIG_BT_CTLR_SYNC_ISO=y
CONFIG_BT_CTLR_SCAN_DATA_LEN_MAX=255
# Supports the highest SDU size required by any BAP LC3 presets (155)
CONFIG_BT_CTLR_ISO_TX_BUFFER_SIZE=155
CONFIG_BT_CTLR_ADV_DATA_LEN_MAX=191
# Only 1 stream support by controller at this point
CONFIG_BT_CTLR_ADV_ISO_STREAM_COUNT=1
# Only 1 stream support by controller at this point
CONFIG_BT_CTLR_SYNC_ISO_STREAM_MAX=1
CONFIG_BT_CTLR_ISO_TX_BUFFERS=3

CONFIG_BT_CTLR_CENTRAL_ISO=y
```

## src/main.c
```c
/*
 * Copyright (c) 2020-2021 Nordic Semiconductor ASA
 * Copyright (c) 2020 Nordic Semiconductor ASA
 *
 * SPDX-License-Identifier: Apache-2.0
 */

#include "bstests.h"

extern struct bst_test_list *test_vcs_install(struct bst_test_list *tests);
extern struct bst_test_list *test_vcs_client_install(struct bst_test_list *tests);
extern struct bst_test_list *test_mics_install(struct bst_test_list *tests);
extern struct bst_test_list *test_mics_client_install(struct bst_test_list *tests);
extern struct bst_test_list *test_tbs_install(struct bst_test_list *tests);
extern struct bst_test_list *test_ccp_install(struct bst_test_list *tests);
extern struct bst_test_list *test_csis_install(struct bst_test_list *tests);
extern struct bst_test_list *test_csip_install(struct bst_test_list *tests);
extern struct bst_test_list *test_mcs_install(struct bst_test_list *tests);
extern struct bst_test_list *test_mcc_install(struct bst_test_list *tests);
extern struct bst_test_list *test_media_controller_install(struct bst_test_list *tests);
extern struct bst_test_list *test_bass_install(struct bst_test_list *tests);
extern struct bst_test_list *test_bass_client_install(struct bst_test_list *tests);
extern struct bst_test_list *test_bass_broadcaster_install(struct bst_test_list *tests);
extern struct bst_test_list *test_broadcast_source_install(struct bst_test_list *tests);
extern struct bst_test_list *test_broadcast_sink_install(struct bst_test_list *tests);
extern struct bst_test_list *test_unicast_client_install(struct bst_test_list *tests);
extern struct bst_test_list *test_unicast_server_install(struct bst_test_list *tests);
extern struct bst_test_list *test_has_install(struct bst_test_list *tests);

bst_test_install_t test_installers[] = {
	test_vcs_install,
	test_vcs_client_install,
	test_mics_install,
	test_mics_client_install,
	test_tbs_install,
	test_ccp_install,
	test_csis_install,
	test_csip_install,
	test_mcs_install,
	test_mcc_install,
	test_media_controller_install,
	test_bass_install,
	test_bass_client_install,
	test_bass_broadcaster_install,
	test_broadcast_source_install,
	test_broadcast_sink_install,
	test_unicast_client_install,
	test_unicast_server_install,
	test_has_install,
	NULL
};

void main(void)
{
	bst_main();
}
```

## src/has_client_test.c
```c
/*
 * Copyright (c) 2021 Codecoup
 *
 * SPDX-License-Identifier: Apache-2.0
 */

//#ifdef CONFIG_BT_HAS

#include "bluetooth/gatt.h"
#include <bluetooth/bluetooth.h>
#include <bluetooth/audio/has.h>
#include "common.h"

extern enum bst_result bst_result;
static struct bt_has_preset g_has_preset;
static struct bt_has *has;

#define IS_HAS_CLIENT(has) 1

static volatile bool g_bt_init;
static volatile bool g_is_connected;
static volatile bool g_mtu_exchanged;
static volatile bool g_discovery_complete;

static volatile bool g_cb;
static volatile bool g_has_active = 1;
static struct bt_conn *g_conn;
static char g_has_preset_name[41];

/* Callback when connected */
static void connected(struct bt_conn *conn, uint8_t err)
{
	char addr[BT_ADDR_LE_STR_LEN];

	bt_addr_le_to_str(bt_conn_get_dst(conn), addr, sizeof(addr));

	if (err) {
		FAIL("Failed to connect to %s (%u)\n", addr, err);
		return;
	}
	printk("Connected to %s\n", addr);
	g_conn = conn;
	g_is_connected = true;
}

BT_CONN_CB_DEFINE(conn_callbacks) = {
	.connected = connected,
	.disconnected = disconnected,
};

// TODO: Implement callback
static void has_active_preset_set_cb(struct bt_has *has, int err, int index)
{
	if (err) {
		FAIL("HAS active preset set cb err\n");
		return;
	}
	g_cb = true;
}

// TODO: Implement callback
static void has_active_preset_get_cb(struct bt_has *has, int err, int index)
{
	if (err) {
		FAIL("HAS active preset get cb err\n");
		return;
	}
	g_cb = true;
}

// TODO: Implement callback
static void has_active_preset_set_next_cb(struct bt_has *has, int err)
{
	if (err) {
		FAIL("HAS active preset set next cb err\n");
		return;
	}
	g_cb = true;
}

// TODO: Implement callback
static void has_active_preset_set_prev_cb(struct bt_has *has, int err)
{
	if (err) {
		FAIL("HAS active preset set prev cb err\n");
		return;
	}
	g_cb = true;
}

// TODO: Implement callback
static void has_preset_list_get_cb(struct bt_has *has, int err)
{
	if (err) {
		FAIL("HAS preset list get cb err\n");
		return;
	}
	g_cb = true;
}

// TODO: Implement callback
static void has_preset_name_set_cb(struct bt_has *has, int err, char *name)
{
	if (err) {
		FAIL("HAS preset name changed cb err\n");
		return;
	}
	if (strlen(name) > sizeof(g_has_preset_name) - 1) {
		printk("Warning: HAS preset name (%zu) is larger than buffer (%zu)\n",
			strlen(name), sizeof(g_has_preset_name) - 1);
	}
	strncpy(g_has_preset_name, name, sizeof(g_has_preset_name) - 1);
	g_has_preset_name[sizeof(g_has_preset_name) - 1] = '\0';
	g_cb = true;
}

static struct bt_has_cb has_cb = {
	.active_preset_set = has_active_preset_set_cb,
	.active_preset_get = has_active_preset_get_cb,
	.active_preset_set_next = has_active_preset_set_next_cb,
	.active_preset_set_prev = has_active_preset_set_prev_cb,
	.preset_list_get = has_preset_list_get_cb,
	.preset_name_set = has_preset_name_set_cb,
};

static void mtu_cb(struct bt_conn *conn, uint8_t err,
		   struct bt_gatt_exchange_params *params)
{
	if (err) {
		FAIL("Failed to exchange MTU (%u)\n", err);
		return;
	}

	g_mtu_exchanged = true;
}

static struct bt_conn_cb conn_callbacks = {
	.connected = connected,
	.disconnected = disconnected,
};

static void bt_ready(int err)
{
	if (err) {
		FAIL("Bluetooth discover failed (err %d)\n", err);
		return;
	}

	g_bt_init = true;
}

static void test_has_preset_name_set(void)
{
	int err;
	char expected_preset_name[40];
	struct bt_has_register_param has_param;

	printk("HAS write preset name test\n");
	strncpy(expected_preset_name, "New preset name",
		sizeof(expected_preset_name));
	expected_preset_name[sizeof(expected_preset_name) - 1] = '\0';
	g_cb = false;
	err = bt_has_preset_name_set(has, 0, expected_preset_name);
	if (err) {
		FAIL("HAS write preset name failed\n");
		return;
	}
	WAIT_FOR(g_cb && !strncmp(expected_preset_name, g_has_preset_name,
					sizeof(expected_preset_name)));
	printk("HAS write preset name success\n");
}

static void test_has_preset_list_get(void)
{
	int err;

	printk("Read all HAS presets test\n");
	g_cb = false;
	err = bt_has_preset_list_get(has);
	if (err) {
		FAIL("HAS read all presets failed\n");
		return;
	}
	WAIT_FOR(g_cb);
	printk("HAS presets read success\n");
}

static void test_has_preset_get(void)
{
	int err;

	printk("HAS read preset by index test\n");
	g_cb = false;
	err = bt_has_preset_get(has, 0);
	if (err) {
		FAIL("HAS read preset by index failed\n");
		return;
	}
	WAIT_FOR(g_cb);
	printk("HAS preset by index read success\n");
}

static void test_has_active_preset_get(void)
{
	int err;

	printk("HAS active preset get test\n");
	g_cb = false;
	err = bt_has_preset_active_get(has);
	if (err) {
		FAIL("HAS get active preset failed\n");
	}
	WAIT_FOR(g_cb);
	printk("HAS get active preset success\n");
}

static void test_has_active_preset_set(void)
{
	int err;

	printk("HAS set active preset set test\n");
	g_cb = false;
	err = bt_has_preset_active_set(has);
	if (err) {
		FAIL("HAS set active preset failed\n");
	}
	WAIT_FOR(g_cb);
	printk("HAS set active preset success\n");
}

static void test_has_active_preset_set_next(void)
{
	int err;

	printk("HAS set next preset test\n");
	g_cb = false;
	err = bt_has_preset_active_set_next(has);
	if (err) {
		FAIL("HAS set next preset failed\n")
	}
	WAIT_FOR(g_cb);
	printk("HAS set next preset success\n");
}

static void test_has_active_preset_set_prev(void)
{
	int err;

	printk("HAS set previous preset test\n");
	g_cb = false;
	err = bt_has_preset_active_set_prev(has);
	if (err) {
		FAIL("HAS set previous preset failed\n");
	}
	WAIT_FOR(g_cb);
	printk("HAS set previous preset\n");
}

/* Main testing function TODO: Needs work */
static void test_main(void)
{
	int err;
	char preset_name[CONFIG_BT_HAS_PRESET_COUNT][41];
	static struct bt_has_register_param has_param;

	static struct bt_gatt_exchange_params mtu_params = {
		.func = mtu_cb,
	};

	struct bt_conn *cached_conn;

	err = bt_enable(bt_ready);

	if (err) {
		FAIL("Bluetooth discover failed (err %d)\n", err);
		return;
	}

	printk("Bluetooth initialized\n");

	memset(&has_param, 0, sizeof(has_param));

	for (int i = 0; i < ARRAY_SIZE(has_param.preset_list); i++) {
		has_param.preset_list[i].index = (uint8_t)i;
		has_param.preset_list[i].properties = BT_HAS_PROP_WRITABLE |
						      BT_HAS_PROP_AVAILABLE;
		snprintf(preset_name[i], sizeof(preset_name[i]),
			 "Preset %d", i + 1);
		has_param.preset_list[i].name = preset_name[i];
	}

	err = bt_has_register(&has_param, &has);
	if (err) {
		FAIL("HAS register failed (err %d)\n", err);
		return;
	}

	err = bt_has_cb_register(&has_cb);
	if (err) {
		FAIL("HAS CB register failed (err %d)\n", err);
		return;
	}

	WAIT_FOR(g_bt_init);

	err = bt_le_scan_start(BT_LE_SCAN_PASSIVE, device_found);
	if (err) {
		FAIL("Scanning failed to start (err %d)\n", err);
		return;
	}
	printk("Scanning succesfully started\n");

	WAIT_FOR(g_is_connected);

	err = bt_gatt_exchange_mtu(g_conn, &mtu_params);
	if (err) {
		FAIL("Failed to exchange MTU %d\n", err);
	}

	err = bt_has_discover(g_conn, &has);
	if (err) {
		FAIL("Failed to discover HAS %d\n", err);
	}

	printk("Getting HAS client conn\n");
	err = bt_has_conn_get(has, &cached_conn);
	if (err != 0) {
		FAIL("Could not get HAS client conn (err %d)\n");
		return;
	}
	if (cached_conn != g_conn) {
		FAIL("Cached conn was not the conn used to discover\n");
		return;
	}

	test_has_preset_list_get();
	test_has_preset_get();
	test_has_active_preset_set();
	test_has_active_preset_get();
	test_has_active_preset_set_next();
	test_has_active_preset_set_prev();
	test_has_preset_name_set();

	PASS("HAS client passed\n");
}

static const struct bst_test_instance test_has[] = {
	{
		.test_id = "has_client",
		.test_post_init_f = test_init,
		.test_tick_f = test_tick,
		.test_main_f = test_main
	},
	BSTEST_END_MARKER
};

struct bst_test_list *test_has_client_install(struct bst_test_list *tests)
{
	return bst_add_tests(tests, test_has);
}

//#endif /* CONFIG_BT_HAS */
```

## src/has_test.c
```c
/*
 * Copyright (c) 2022 Codecoup
 *
 * SPDX-License-Identifier: Apache-2.0
 */

#ifdef CONFIG_BT_HAS
#include "bluetooth/audio/has.h"
#include "common.h"

extern enum bst_result_t bst_result;

static struct bt_has *has;

static struct bt_conn *g_conn;
static bool g_is_connected;

static struct bt_has_cb has_cb = {

};

static void connected(struct bt_conn *conn, uint8_t err)
{
	char addr[BT_ADDR_LE_STR_LEN];

	bt_addr_le_to_str(bt_conn_get_dst(conn), addr, sizeof(addr));

	if (err) {
		FAIL("Failed to connect to %s (%u)\n", addr, err);
		return;
	}
	printk("Connected to %s\n", addr);
	g_conn = conn;
	g_is_connected = true;
}

BT_CONN_CB_DEFINE(conn_callbacks) = {
	.connected = connected,
	.disconnected = disconnected,
};

static void test_standalone(void)
{
	int err;
	struct bt_has_register_param has_param;
	char preset_name[CONFIG_BT_HAS_PRESET_COUNT][41];

	err = bt_enable(NULL);
	if (err) {
		FAIL("Bluetooth init failed (err %d)\n", err);
		return;
	}

	printk("Bluetooth initialized\n");

	memset(&has_param, 0, sizeof(has_param));

	for (int i = 0; i < ARRAY_SIZE(has_param.preset_list); i++) {
		has_param.preset_list[i].index = (uint8_t)i;
		has_param.preset_list[i].properties = BT_HAS_PROP_WRITABLE |
						      BT_HAS_PROP_AVAILABLE;
		snprintf(preset_name[i], sizeof(preset_name[i]),
			 "Preset %d", i + 1);
		has_param.preset_list[i].name = preset_name[i];
	}

	has_param.cb = &has_cb;

	err = bt_has_register(&has_param, &has);
	if (err) {
		FAIL("HAS register failed (err %d)\n", err);
		return;
	}

	PASS("HAS passed\n");
}

static const struct bst_test_instance test_has[] = {
	{
		.test_id = "has_standalone",
		.test_post_init_f = test_init,
		.test_tick_f = test_tick,
		.test_main_f = test_standalone
	},
	BSTEST_END_MARKER
};

struct bst_test_list *test_has_install(struct bst_test_list *tests)
{
	return bst_add_tests(tests, test_has);
}
#else
struct bst_test_list *test_has_install(struct bst_test_list *tests)
{
	return tests;
}

#endif /* CONFIG_BT_HAS */
```

## src/unicast_client_test.c
```c
/*
 * Copyright (c) 2021-2022 Nordic Semiconductor ASA
 *
 * SPDX-License-Identifier: Apache-2.0
 */

#if defined(CONFIG_BT_AUDIO_UNICAST_CLIENT)

#include <zephyr/bluetooth/bluetooth.h>
#include <zephyr/bluetooth/audio/audio.h>
#include <zephyr/bluetooth/audio/pacs.h>
#include "common.h"
#include "unicast_common.h"

extern enum bst_result_t bst_result;

static struct bt_audio_stream g_streams[CONFIG_BT_AUDIO_UNICAST_CLIENT_ASE_SNK_COUNT];
static struct bt_codec *g_remote_codecs[CONFIG_BT_AUDIO_UNICAST_CLIENT_PAC_COUNT];
static struct bt_audio_ep *g_sinks[CONFIG_BT_AUDIO_UNICAST_CLIENT_ASE_SNK_COUNT];

/* Mandatory support preset by both client and server */
static struct bt_audio_lc3_preset preset_16_2_1 =
	BT_AUDIO_LC3_UNICAST_PRESET_16_2_1(BT_AUDIO_LOCATION_FRONT_LEFT,
					   BT_AUDIO_CONTEXT_TYPE_UNSPECIFIED);

CREATE_FLAG(flag_connected);
CREATE_FLAG(flag_mtu_exchanged);
CREATE_FLAG(flag_sink_discovered);
CREATE_FLAG(flag_stream_configured);
CREATE_FLAG(flag_stream_qos);
CREATE_FLAG(flag_stream_enabled);
CREATE_FLAG(flag_stream_released);

static void stream_configured(struct bt_audio_stream *stream,
			      const struct bt_codec_qos_pref *pref)
{
	printk("Configured stream %p\n", stream);

	/* TODO: The preference should be used/taken into account when
	 * setting the QoS
	 */

	SET_FLAG(flag_stream_configured);
}

static void stream_qos_set(struct bt_audio_stream *stream)
{
	printk("QoS set stream %p\n", stream);

	SET_FLAG(flag_stream_qos);
}

static void stream_enabled(struct bt_audio_stream *stream)
{
	printk("Enabled stream %p\n", stream);

	SET_FLAG(flag_stream_enabled);
}

static void stream_started(struct bt_audio_stream *stream)
{
	printk("Started stream %p\n", stream);
}

static void stream_metadata_updated(struct bt_audio_stream *stream)
{
	printk("Metadata updated stream %p\n", stream);
}

static void stream_disabled(struct bt_audio_stream *stream)
{
	printk("Disabled stream %p\n", stream);
}

static void stream_stopped(struct bt_audio_stream *stream)
{
	printk("Stopped stream %p\n", stream);
}

static void stream_released(struct bt_audio_stream *stream)
{
	printk("Released stream %p\n", stream);

	SET_FLAG(flag_stream_released);
}

static struct bt_audio_stream_ops stream_ops = {
	.configured = stream_configured,
	.qos_set = stream_qos_set,
	.enabled = stream_enabled,
	.started = stream_started,
	.metadata_updated = stream_metadata_updated,
	.disabled = stream_disabled,
	.stopped = stream_stopped,
	.released = stream_released,
};

static void unicast_client_location_cb(struct bt_conn *conn,
				       enum bt_audio_dir dir,
				       enum bt_audio_location loc)
{
	printk("dir %u loc %X\n", dir, loc);
}

static void available_contexts_cb(struct bt_conn *conn,
				  enum bt_audio_context snk_ctx,
				  enum bt_audio_context src_ctx)
{
	printk("snk ctx %u src ctx %u\n", snk_ctx, src_ctx);
}

const struct bt_audio_unicast_client_cb unicast_client_cbs = {
	.location = unicast_client_location_cb,
	.available_contexts = available_contexts_cb,
};

static void add_remote_sink(struct bt_audio_ep *ep, uint8_t index)
{
	printk("Sink #%u: ep %p\n", index, ep);

	g_sinks[index] = ep;
}

static void add_remote_codec(struct bt_codec *codec, int index,
			     enum bt_audio_dir dir)
{
	printk("#%u: codec %p dir 0x%02x\n", index, codec, dir);

	print_codec(codec);

	if (dir != BT_AUDIO_DIR_SINK && dir != BT_AUDIO_DIR_SOURCE) {
		return;
	}

	if (index < CONFIG_BT_AUDIO_UNICAST_CLIENT_PAC_COUNT) {
		g_remote_codecs[index] = codec;
	}
}

static void discover_sink_cb(struct bt_conn *conn,
			    struct bt_codec *codec,
			    struct bt_audio_ep *ep,
			    struct bt_audio_discover_params *params)
{
	static bool codec_found;
	static bool endpoint_found;

	if (params->err != 0) {
		FAIL("Discovery failed: %d\n", params->err);
		return;
	}

	if (codec != NULL) {
		add_remote_codec(codec, params->num_caps, params->dir);
		codec_found = true;
		return;
	}

	if (ep != NULL) {
		if (params->dir == BT_AUDIO_DIR_SINK) {
			add_remote_sink(ep, params->num_eps);
			endpoint_found = true;
		} else {
			FAIL("Invalid param dir: %u\n", params->dir);
		}

		return;
	}

	printk("Discover complete\n");

	(void)memset(params, 0, sizeof(*params));

	if (endpoint_found && codec_found) {
		SET_FLAG(flag_sink_discovered);
	} else {
		FAIL("Did not discover endpoint and codec\n");
	}
}

static void connected(struct bt_conn *conn, uint8_t err)
{
	char addr[BT_ADDR_LE_STR_LEN];

	(void)bt_addr_le_to_str(bt_conn_get_dst(conn), addr, sizeof(addr));

	if (err != 0) {
		bt_conn_unref(default_conn);
		default_conn = NULL;

		FAIL("Failed to connect to %s (%u)\n", addr, err);
		return;
	}

	printk("Connected to %s\n", addr);
	SET_FLAG(flag_connected);
}

BT_CONN_CB_DEFINE(conn_callbacks) = {
	.connected = connected,
	.disconnected = disconnected,
};

static void att_mtu_updated(struct bt_conn *conn, uint16_t tx, uint16_t rx)
{
	printk("MTU exchanged\n");
	SET_FLAG(flag_mtu_exchanged);
}

static struct bt_gatt_cb gatt_callbacks = {
	.att_mtu_updated = att_mtu_updated,
};

static void init(void)
{
	int err;

	err = bt_enable(NULL);
	if (err != 0) {
		FAIL("Bluetooth enable failed (err %d)\n", err);
		return;
	}

	for (size_t i = 0; i < ARRAY_SIZE(g_streams); i++) {
		g_streams[i].ops = &stream_ops;
	}

	bt_gatt_cb_register(&gatt_callbacks);

	err = bt_audio_unicast_client_register_cb(&unicast_client_cbs);
	if (err != 0) {
		FAIL("Failed to register client callbacks: %d", err);
		return;
	}
}

static void scan_and_connect(void)
{
	int err;

	err = bt_le_scan_start(BT_LE_SCAN_PASSIVE, device_found);
	if (err != 0) {
		FAIL("Scanning failed to start (err %d)\n", err);
		return;
	}

	printk("Scanning successfully started\n");
	WAIT_FOR_FLAG(flag_connected);
}

static void exchange_mtu(void)
{
	WAIT_FOR_FLAG(flag_mtu_exchanged);
}

static void discover_sink(void)
{
	static struct bt_audio_discover_params params;
	int err;

	params.func = discover_sink_cb;
	params.dir = BT_AUDIO_DIR_SINK;

	err = bt_audio_discover(default_conn, &params);
	if (err != 0) {
		printk("Failed to discover sink: %d\n", err);
		return;
	}

	WAIT_FOR_FLAG(flag_sink_discovered);
}

static int configure_stream(struct bt_audio_stream *stream,
			    struct bt_audio_ep *ep)
{
	int err;

	UNSET_FLAG(flag_stream_configured);

	err = bt_audio_stream_config(default_conn, stream, ep,
				     &preset_16_2_1.codec);
	if (err != 0) {
		FAIL("Could not configure stream: %d\n", err);
		return err;
	}

	WAIT_FOR_FLAG(flag_stream_configured);

	return 0;
}

static void configure_streams(size_t stream_num)
{
	printk("Configuring %zu %s\n",
		stream_num, stream_num > 1 ? "streams" : "stream");

	__ASSERT_NO_MSG(stream_num <= ARRAY_SIZE(g_sinks));

	for (size_t i = 0; i < stream_num; i++) {
		struct bt_audio_stream *stream = &g_streams[i];
		int err;

		if (g_sinks[i] == NULL) {
			break;
		}

		err = configure_stream(stream, g_sinks[i]);
		if (err != 0) {
			FAIL("Unable to configure stream[%zu]: %d", i, err);
			return;
		}
	}
}

static size_t release_streams(size_t stream_cnt)
{
	for (size_t i = 0; i < stream_cnt; i++) {
		int err;

		if (g_sinks[i] == NULL) {
			break;
		}

		UNSET_FLAG(flag_stream_released);

		err = bt_audio_stream_release(&g_streams[i]);
		if (err != 0) {
			FAIL("Unable to release stream[%zu]: %d", i, err);
			return 0;
		}

		WAIT_FOR_FLAG(flag_stream_released);
	}

	return stream_cnt;
}


static void create_unicast_group(struct bt_audio_unicast_group **unicast_group,
				 size_t stream_cnt)
{
	struct bt_audio_unicast_group_stream_param stream_params[ARRAY_SIZE(g_streams)];
	struct bt_audio_unicast_group_param param;
	int err;

	printk("Creating unicast group with %zu streams\n", stream_cnt);

	for (size_t i = 0U; i < stream_cnt; i++) {
		stream_params[i].in = NULL;
		stream_params[i].out = &g_streams[i];
		stream_params[i].qos = &preset_16_2_1.qos;
	}

	param.params = stream_params;
	param.params_count = stream_cnt;
	param.packing = BT_ISO_PACKING_SEQUENTIAL;

	/* Require controller support for CIGs */
	err = bt_audio_unicast_group_create(&param, unicast_group);
	if (err != 0) {
		FAIL("Unable to create unicast group: %d", err);
	}
}

static void delete_unicast_group(struct bt_audio_unicast_group *unicast_group)
{
	int err;

	printk("Deleting unicast group\n");

	err = bt_audio_unicast_group_delete(unicast_group);
	if (err != 0) {
		FAIL("Unable to delete unicast group: %d", err);
	}
}

static void test_main(void)
{
	const size_t stream_cnt = CONFIG_BT_AUDIO_UNICAST_CLIENT_ASE_SNK_COUNT;
	struct bt_audio_unicast_group *unicast_group;

	init();

	scan_and_connect();

	exchange_mtu();

	discover_sink();

	if (IS_ENABLED(CONFIG_BT_CTLR_CENTRAL_ISO)) {
		create_unicast_group(&unicast_group, stream_cnt);
	}

	/* Run the stream setup multiple time to ensure states are properly
	 * set and reset
	 */
	for (unsigned int i = 0U; i < stream_cnt; i++) {
		const size_t stream_num = i + 1;

		configure_streams(stream_num);

		/* TODO: When babblesim supports ISO setup Audio streams */

		release_streams(stream_num);
	}

	if (IS_ENABLED(CONFIG_BT_CTLR_CENTRAL_ISO)) {
		delete_unicast_group(unicast_group);
		unicast_group = NULL;
	}

	PASS("Unicast client passed\n");
}

static void test_group(void)
{
	init();

	if (IS_ENABLED(CONFIG_BT_CTLR_CENTRAL_ISO)) {
		const size_t stream_cnt = CONFIG_BT_AUDIO_UNICAST_CLIENT_ASE_SNK_COUNT;
		const unsigned int iterations = 3;
		struct bt_audio_unicast_group *unicast_group;

		/* Run the group setup multiple time to ensure states are properly
		 * created and deleted
		 */
		for (unsigned int i = 0U; i < iterations; i++) {
			printk("\n########### Running iteration #%u\n\n", i);

			printk("Creating unicast group\n");
			create_unicast_group(&unicast_group, stream_cnt);

			printk("Deleting unicast group\n");
			delete_unicast_group(unicast_group);

			unicast_group = NULL;
		}
	} else {
		printk("test skipped, CONFIG_BT_CTLR_CENTRAL_ISO not set\n");
	}

	PASS("Unicast group passed\n");
}

static const struct bst_test_instance test_unicast_client[] = {
	{
		.test_id = "unicast_client",
		.test_post_init_f = test_init,
		.test_tick_f = test_tick,
		.test_main_f = test_main
	},
	{
		.test_id = "unicast_group",
		.test_post_init_f = test_init,
		.test_tick_f = test_tick,
		.test_main_f = test_group
	},
	BSTEST_END_MARKER
};

struct bst_test_list *test_unicast_client_install(struct bst_test_list *tests)
{
	return bst_add_tests(tests, test_unicast_client);
}

#else /* !(CONFIG_BT_AUDIO_UNICAST_CLIENT) */

struct bst_test_list *test_unicast_client_install(struct bst_test_list *tests)
{
	return tests;
}

#endif /* CONFIG_BT_AUDIO_UNICAST_CLIENT */
```
