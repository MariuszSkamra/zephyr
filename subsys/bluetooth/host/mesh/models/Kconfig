## subsys/bluetooth/host/mesh/models/Kconfig
```kconfig
# Kconfig - Bluetooth Mesh Model configuration options

#
# Copyright (c) 2019 Intel Corporation
#
# SPDX-License-Identifier: Apache-2.0
#

menu "Bluetooth SIG Mesh Models support"

comment "Mesh Generic Models"

endmenu
```
